## app/dmc/sample.yaml
```yaml
sample:
  name: DMFW
common:
  sysbuild: true
  platform_allow:
    - tt_blackhole@p100a/tt_blackhole/dmc
    - tt_blackhole@p150a/tt_blackhole/dmc
    - tt_blackhole@p300a/tt_blackhole/dmc
  harness: console
  harness_config:
    type: one_line
    regex:
      - "DMFW VERSION (.*)"
tests:
  sample.app:
    extra_configs:
      - CONFIG_DMC_RUN_SMBUS_TESTS=y
    tags: e2e
  sample.app.native_sim_build:
    platform_allow:
      - native_sim
    sysbuild: false
    build_only: true
    tags:
      - build
      - native_sim
      - build-ci
  sample.app.tt_bh_sim_mgmt_build:
    platform_allow:
      - tt_bh_sim_mgmt
    sysbuild: false
    build_only: true
    tags:
      - build
      - sim
      - build-ci
```

## boards/tenstorrent/tt_bh_sim_mgmt/Kconfig.defconfig
```kconfig
# SPDX-License-Identifier: Apache-2.0

if BOARD_TT_BH_SIM_MGMT

config BUILD_OUTPUT_BIN
	default y

endif # BOARD_TT_BH_SIM_MGMT
```

## boards/tenstorrent/tt_bh_sim_mgmt/Kconfig.tt_bh_sim_mgmt
```kconfig
# Copyright (c) 2026 Tenstorrent AI ULC
# SPDX-License-Identifier: Apache-2.0

config BOARD_TT_BH_SIM_MGMT
	select SOC_QEMU_VIRT_RISCV64
	select QEMU_TARGET
```

## boards/tenstorrent/tt_bh_sim_mgmt/board.yml
```yaml
board:
  name: tt_bh_sim_mgmt
  full_name: Tenstorrent Blackhole Management RV64 (ttsim)
  vendor: tenstorrent
  socs:
    - name: qemu_virt_riscv64
```

## boards/tenstorrent/tt_bh_sim_mgmt/tt_bh_sim_mgmt_defconfig
```kconfig
# SPDX-License-Identifier: Apache-2.0

CONFIG_XIP=n
CONFIG_RISCV_PMP=n
CONFIG_CONSOLE=n
CONFIG_SERIAL=n
CONFIG_QEMU_ICOUNT_SHIFT=6
```

## boards/tenstorrent/tt_mmk/board.yml
```yaml
board:
  name: tt_mmk
  full_name: Tenstorrent MMK Board
  vendor: tenstorrent
  socs:
    - name: tt_keraunos
    - name: tt_mimir
```

## drivers/misc/tt_bundle_loader/Kconfig
```kconfig
# Copyright (c) 2026 Tenstorrent AI ULC
# SPDX-License-Identifier: Apache-2.0

config TT_BUNDLE_LOADER
	bool "Tenstorrent SMC FW Bundle Loader Remote Driver"
	default n
	help
	  Enable the Bundle Loader driver for the Tenstorrent SMC platform.

if TT_BUNDLE_LOADER
module = TT_BUNDLE_LOADER
module-str = tt_bundle_loader
source "subsys/logging/Kconfig.template.log_config"

endif # TT_BUNDLE_LOADER

config TT_MMK_BUN2_LOADER
	bool "Tenstorrent MMK BUN2 (host-staged) FW Bundle Loader"
	default y
	select TT_BUNDLE_LOADER
	depends on DT_HAS_TENSTORRENT_MMK_BUN2_LOADER_ENABLED
	help
	  Enable the BUN2 (host-staged) FW bundle loader driver for the Tenstorrent MMK SMC
	  platform.

if TT_MMK_BUN2_LOADER

config TT_MMK_BUN2_LOADER_INIT_PRIO
	int
	default 76
	help
	  Set the initialization priority of the Tenstorrent MMK BUN2 loader driver.

module = TT_MMK_BUN2_LOADER
module-str = tt_mmk_bun2_loader
source "subsys/logging/Kconfig.template.log_config"

endif # TT_MMK_BUN2_LOADER
```

## drivers/pmci/pldm/Kconfig
```kconfig
# Copyright (c) 2026 Tenstorrent AI ULC
# SPDX-License-Identifier: Apache-2.0

config PMCI_PLDM_PLATFORM
	bool "Enable PLDM Platform support"
	depends on PLDM && SENSOR_ASYNC_API
	default y
	help
	  Enable PLDM Platform command handling and PDR repository support.

config PMCI_PLDM_OEM
	bool "Enable PLDM OEM support"
	depends on PLDM
	help
	  Enable PLDM OEM support. OEM functionality must be provided by a compatible
	  device implementing the PLDM OEM handler API.

config PMCI_PLDM_BASE
	bool "Enable PLDM Base support"
	depends on PLDM
	help
	  Enable PLDM BASE support

config TT_PMCI_PLDM_SHELL
	bool "Enable PLDM OEM shell bridge"
	depends on SHELL
	depends on PMCI_PLDM_OEM
	select SHELL_BACKEND_DUMMY
	help
	  Enable an OEM PLDM command set that executes shell commands through
	  Zephyr shell APIs and returns captured output over MCTP/PLDM.
	  This is intended for bring-up and debug images.

config TT_PMCI_PLDM_MCTP_RESPONDER
	bool "Tenstorrent PLDM responder over MCTP"
	depends on DT_HAS_TENSTORRENT_PLDM_MCTP_RESPONDER_ENABLED
	depends on MCTP && PLDM && MCTP_I3C_TARGET
	select PMCI_PLDM_BASE
	select PMCI_PLDM_PLATFORM
	help
	  Enable Tenstorrent PLDM responder over an MCTP I3C target transport.
	  The driver consumes PLDM messages and emits responses for supported
	  PLDM Base and Platform commands.
```

## dts/bindings/mbox/tenstorrent,grendel-mbox.yaml
```yaml
# Copyright (c) 2026 Tenstorrent AI ULC
# SPDX-License-Identifier: Apache-2.0

description: Tenstorrent Grendel Mailbox

compatible: "tenstorrent,grendel-mbox"

include: [base.yaml, mailbox-controller.yaml]

properties:
  reg:
    required: true

  interrupts:
    description: |
      Required for instances that receive on inbound channels. Instances that
      only ever send (e.g. a remote view of another die's mailbox registers)
      may omit interrupts entirely.

  channel-pairs:
    type: int
    required: true
    description: |
      The number of outbound/inbound channel pairs supported by the mailbox
      controller. The total number of channels is twice this value.

mbox-cells:
  - channel
```

## dts/bindings/misc/tenstorrent,mmk-bun2-loader.yaml
```yaml
# Copyright (c) 2026 Tenstorrent AI ULC
# SPDX-License-Identifier: Apache-2.0

description: |
  Tenstorrent MMK BUN2 (host-staged) FW bundle loader.

  Drives the host handshake used to stage and validate the FW bundle used to boot the SMC:
    1. Set the host boot state register to WAIT_FOR_BUNDLE.
    2. Poll the host boot state register for BUNDLE_STAGED.
    3. Close host access to the staging region.
    4. Set the bundle validation register's BUNDLE_READY_FOR_VALIDATION bit.
    5. Poll the bundle validation register for its BUNDLE_VALIDATED bit.
    6. Copy the SMC BL1 image out of the staged bundle to its execution address and jump to it.

compatible: "tenstorrent,mmk-bun2-loader"

include: base.yaml

properties:
  reg:
    required: true
    description: |
      The BUN2 staging area. The host writes the FW bundle payload (manifest, TOC and images)
      here before requesting validation.

  host-boot-state:
    type: phandle
    required: true
    description: |
      tenstorrent,scratch-reg node used for the host boot state handshake (K-SMC SCRATCH[12]).

  bundle-validation:
    type: phandle
    required: true
    description: |
      tenstorrent,scratch-reg node used for the bundle validation handshake (K-SMC SCRATCH[10]).
```

## dts/bindings/misc/tenstorrent,pldm-mctp-responder.yaml
```yaml
# Copyright (c) 2026 Tenstorrent AI ULC
# SPDX-License-Identifier: Apache-2.0

description: Tenstorrent PLDM responder over MCTP I3C target transport

compatible: "tenstorrent,pldm-mctp-responder"

include: base.yaml

properties:
  mctp-target:
    type: phandle
    required: true
    description: Phandle to a zephyr,mctp-i3c-target node

  pdr:
    type: phandle
    description: Optional phandle to a tenstorrent,pldm-pdr node

  oem-handler:
    type: phandle
    description: Optional phandle to a tenstorrent,pldm-oem-handler node

  pldm-tid:
    type: int
    default: 11
    description: PLDM terminus ID reported by GetTID
```

## dts/bindings/misc/tenstorrent,pldm-oem-handler.yaml
```yaml
# Copyright (c) 2026 Tenstorrent AI ULC
# SPDX-License-Identifier: Apache-2.0

description: Tenstorrent PLDM OEM command handler

compatible: "tenstorrent,pldm-oem-handler"

include: base.yaml
```

## tests/drivers/pmci/pldm/testcase.yaml
```yaml
common:
  tags:
    - pldm
    - mctp
    - dmc
  platform_allow:
    - nucleo_u385rg_q
  integration_platforms:
    - nucleo_u385rg_q

tests:
  drivers.pldm.nucleo: {}
```
